## ESP32MQTT/main/Kconfig.projbuild
```kconfig
menu "Example Configuration"

    config BROKER_URI
        string "Broker URL"
        default "mqtts://mqtt.eclipseprojects.io:8883"
        help
            URL of an mqtt broker which this example connects to.

    config CLIENT_ID
        string "Client ID"
        default "espDevice"
        help
            Client ID used to identify this device to the broker.

endmenu
```

## mqtt/AzureMqttIoTClient/Kconfig.projbuild
```kconfig
menu "Azure MQTT IoT Client Configuration"
    config BROKER_URI
        string "MQTT Broker URI"
        default "mqtt://example.com"

    config DEVICE_ID
        string "Device ID"
        default "espDevice"
endmenu
```
